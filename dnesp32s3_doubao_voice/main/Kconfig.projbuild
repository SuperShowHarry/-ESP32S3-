## dnesp32s3_doubao_voice/main/Kconfig.projbuild
```kconfig
menu "DNESP32S3 Doubao Voice Assistant"

config APP_WIFI_SSID
    string "Wi-Fi SSID"
    default "YOUR_WIFI_NAME"

config APP_WIFI_PASSWORD
    string "Wi-Fi password"
    default "YOUR_WIFI_PASSWORD"

choice APP_SPI_LCD_TYPE
    prompt "SPI ST7789 display"
    default APP_SPI_LCD_320X240

config APP_SPI_LCD_320X240
    bool "2.4-inch 320x240 ST7789 (recommended)"

config APP_SPI_LCD_240X240
    bool "1.3-inch 240x240 ST7789"

endchoice

choice DOUBAO_AUTH_MODE
    prompt "Doubao authentication mode"
    default DOUBAO_AUTH_API_KEY

config DOUBAO_AUTH_API_KEY
    bool "New console API Key (recommended)"

config DOUBAO_AUTH_LEGACY
    bool "Legacy App ID + Access Token"

endchoice

config DOUBAO_API_KEY
    string "Doubao Voice API Key"
    default ""
    depends on DOUBAO_AUTH_API_KEY

config DOUBAO_APP_ID
    string "Legacy App ID"
    default ""
    depends on DOUBAO_AUTH_LEGACY

config DOUBAO_ACCESS_TOKEN
    string "Legacy Access Token"
    default ""
    depends on DOUBAO_AUTH_LEGACY

config DOUBAO_RESOURCE_ID
    string "Realtime voice resource ID"
    default "volc.speech.dialog"

config DOUBAO_MODEL
    string "Realtime dialogue model"
    default "1.2.1.1"
    help
        1.2.1.1 is the O2.0 model. 2.2.0.0 is the SC2.0 model and requires a matching voice.

config DOUBAO_SPEAKER
    string "Voice ID"
    default "zh_female_vv_jupiter_bigtts"

config DOUBAO_BOT_NAME
    string "Assistant name"
    default "Doubao"

config DOUBAO_SYSTEM_ROLE
    string "System role"
    default "You are a helpful Chinese voice assistant. Reply accurately and briefly in Chinese."

config DOUBAO_SPEAKING_STYLE
    string "Speaking style"
    default "Natural, concise and friendly"

config AUDIO_OUTPUT_VOLUME
    int "Speaker volume (0-100)"
    range 0 100
    default 100

endmenu
```

## dnesp32s3_doubao_voice/sdkconfig.defaults
```kconfig
CONFIG_IDF_TARGET="esp32s3"
CONFIG_ESPTOOLPY_FLASHSIZE_16MB=y
CONFIG_ESPTOOLPY_FLASHMODE_QIO=y
CONFIG_ESPTOOLPY_FLASHFREQ_80M=y
CONFIG_PARTITION_TABLE_CUSTOM=y
CONFIG_PARTITION_TABLE_CUSTOM_FILENAME="partitions.csv"

CONFIG_SPIRAM=y
CONFIG_SPIRAM_MODE_OCT=y
CONFIG_SPIRAM_SPEED_80M=y
CONFIG_SPIRAM_USE_MALLOC=y
CONFIG_SPIRAM_MALLOC_ALWAYSINTERNAL=16384
CONFIG_SPIRAM_MALLOC_RESERVE_INTERNAL=32768

CONFIG_ESP_DEFAULT_CPU_FREQ_MHZ_240=y
CONFIG_ESP_MAIN_TASK_STACK_SIZE=8192
CONFIG_ESP_SYSTEM_EVENT_TASK_STACK_SIZE=4096
CONFIG_FREERTOS_HZ=1000

CONFIG_MBEDTLS_CERTIFICATE_BUNDLE=y
CONFIG_MBEDTLS_CERTIFICATE_BUNDLE_DEFAULT_FULL=y
CONFIG_ESP_TLS_USE_SECURE_ELEMENT=n

# ESP-IDF 5.3+ uses the new I2C master driver. IDF 5.1.2 ignores this
# unavailable option and esp_codec_dev automatically uses legacy I2C.
CONFIG_CODEC_I2C_BACKWARD_COMPATIBLE=n

CONFIG_LV_CONF_SKIP=y
CONFIG_LV_COLOR_DEPTH_16=y
CONFIG_LV_MEM_SIZE_KILOBYTES=48
CONFIG_SPIRAM_TRY_ALLOCATE_WIFI_LWIP=y
CONFIG_MBEDTLS_EXTERNAL_MEM_ALLOC=y
CONFIG_LV_FONT_MONTSERRAT_14=y
CONFIG_LV_FONT_MONTSERRAT_18=y
CONFIG_LV_FONT_SIMSUN_16_CJK=y
CONFIG_LV_USE_FONT_COMPRESSED=y
CONFIG_LV_FONT_DEFAULT_MONTSERRAT_14=y
CONFIG_LV_TXT_ENC_UTF8=y
CONFIG_LV_USE_LABEL=y
CONFIG_LV_USE_BAR=y
CONFIG_LV_USE_FLEX=y
CONFIG_LV_USE_THEME_DEFAULT=y
CONFIG_LV_BUILD_EXAMPLES=n
CONFIG_LV_BUILD_DEMOS=n

CONFIG_LOG_DEFAULT_LEVEL_INFO=y
CONFIG_ESP_COREDUMP_ENABLE_TO_FLASH=y
CONFIG_AUDIO_OUTPUT_VOLUME=100
```
